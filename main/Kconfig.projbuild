## main/Kconfig.projbuild
```kconfig
menu "Lyra Configuration"

config API_BASE_URL
    string "API Base url"
    default "/api/devices/lyra"
    help
	Base API path

config API_PORT
   	int "API Port"
    range 0 66000
    default 443
    help
	Port used in api server

config API_HOST
    string "API Host"
   	default "192.168.1.53"
    help
	API HOST

config INTERRUPT_PIN
   	int "Interrupt pin"
    range 0 50
    default 5
    help
	Port used in api server

config SPIFFS_BASE_ADDR
    hex "SPIFFS base address"
    range 0x100000 0x1FFE000
    default 0x300000
    help
	Starting address of the SPIFFS area in ESP32 Flash
	Write the address in hex format, 0x180000

config SPIFFS_SIZE
    int "Spiffs size"
    range 262144 2097152
    default 1048576

config SPIFFS_LOG_BLOCK_SIZE
    int "spiffs log block size"
    range 4098 65536
    default 8192

config SPIFFS_LOG_PAGE_SIZE
    int "spiffs log page size"
    range 256 2048
    default 256
    help
	Set it to the physical page size og the used SPI Flash chip.



endmenu
```
